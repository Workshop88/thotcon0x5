#include "U8glib.h"
#include <EEPROM.h>
#include <avr/sleep.h>

/*
U8GLIB_DOGS102 u8g(0,4); //teesy 
uint8_t uiKeyPrev = 17;
uint8_t uiKeyNext = 18;
uint8_t uiKeySelect = 14;
uint8_t uiKeyBack = 15;
uint8_t uiKeyRight = 20;
uint8_t uiKeyLeft = 19;
uint8_t led = 11;
*/


U8GLIB_DOGS102 u8g(17,11); //PROTO BOARD
//Leonardo based pin assignements must have updated pins_arduino.h for pin 30
uint8_t uiKeyPrev = 4;
uint8_t uiKeyNext = 0;
uint8_t uiKeySelect = 12;
uint8_t uiKeyBack = 6;
uint8_t uiKeyRight = 30;
uint8_t uiKeyLeft = 1;
uint8_t led = 3;


int isPlayer1 = 1;
char inputs[6] = { 0x04, 0x01, 0x00, 0x1E, 0x06, 0x0C };
char p1keys[7] = { 'W', 'A', 'S', 'D', 'Q', 'E', 'P' };
char p2keys[7] = { 'I', 'J', 'K', 'L', 'U', 'O', 'R' };

//#define DEBUG 1

/*select one badge type for compile*/

#define HACKER_BADGE 1  //BLACK
//#define OPER_BADGE 1    //RED
//#define VOICE_BADGE 1     //BLUE
//#define VIP_BADGE 1     //GREEN
//#define ROOT_BADGE 1     //GOLD

/* Tweak here for idle time, this determines when the badge draws and sleeps
   IDLE_MS should be left below 25 (~human reaction time).
   IDLE_SCALE should be (Target Time)/IDLE_MS
*/
#define IDLE_MS 15
#define IDLE_SCALE 2000
#define IDLE_BYTE 100

#define SCORE_BYTE 200

#define DISPLAY_WIDTH 102
#define L_FONT_HEIGHT 10
#define L_FONT_LENGTH 17 //printable characters per line


//Key States
#define KEY_NONE 0
#define KEY_PREV 1
#define KEY_NEXT 2
#define KEY_SELECT 3
#define KEY_BACK 4
#define KEYLEFT 5
#define KEYRIGHT 6

//Menu SM States
#define MAIN_STATE 255
#define GAME_STATE 0
#define SCHED_STATE 1
#define LINK_STATE 2
#define REG_STATE 3
#define HELP_STATE 4
#define TRACK_ONE_STATE (SCHED_STATE << 4)
#define TRACK_TWO_STATE (SCHED_STATE << 5)
#define LABS_STATE  (SCHED_STATE << 6)
#define VILLAGE_STATE (SCHED_STATE << 7)
#define PARTY_STATE 5

//menu global strings and consts for draw states and such
#define MENU_ITEMS 5
#define TRACK1_ITEMS 16
#define TRACK2_ITEMS 13
#define LAB_ITEMS 7
#define VILLAGE_ITEMS 7

#define DEBUG_MANUAL 1

#define DISPLAY_HEIGHT 64

/*================================================================*/
/* breaker definitions and structures */
/*================================================================*/

///#define BO_F1 font_5x7
///#define BO_F2 font_6x12
///#define BO_F3 font_8x13

#define BO_FP 4

#define BO_AREA_WIDTH 7
#define BO_AREA_HEIGHT 3

#define AREA_WIDTH 7
#define AREA_HEIGHT 3

#define BO_BRICK_WIDTH ( (int16_t)10 << BO_FP )
#define BO_BRICK_HEIGHT ( (int16_t)4 << BO_FP )

#define BRICK_WIDTH 10
#define BRICK_HEIGHT 4

#define BALL_START_X 1
#define BALL_START_Y 4

#define BALL_SIZE 3

#define BALL_SIZE_FP ( 3 << BO_FP )

#define BO_AREA_UNIT_X ( BO_BRICK_WIDTH + ( (int16_t)4 << BO_FP ) )
#define BO_AREA_UNIT_Y ( BO_BRICK_HEIGHT + ( (int16_t)4 << BO_FP ) )
#define BO_AREA_ORIG_X ( (int16_t)2 << BO_FP )
#define BO_AREA_ORIG_Y ( (int16_t)(DISPLAY_HEIGHT - 32) << BO_FP )

#define AREA_UNIT_X ( BRICK_WIDTH + 4 )
#define AREA_UNIT_Y ( BRICK_HEIGHT + 4 )
#define AREA_ORIG_X 2
#define AREA_ORIG_Y ( DISPLAY_HEIGHT - 32 )

/* dimensions of the overall game field (BO_FP units) */
#define BO_FIELD_WIDTH ( BO_AREA_ORIG_X + BO_AREA_UNIT_X * BO_AREA_WIDTH )
#define BO_FIELD_HEIGHT ( BO_AREA_ORIG_Y + BO_AREA_UNIT_Y * BO_AREA_HEIGHT )

#define FIELD_WIDTH ( AREA_ORIG_X + AREA_UNIT_X * AREA_WIDTH )
#define FIELD_HEIGHT ( AREA_ORIG_Y + AREA_UNIT_Y * AREA_HEIGHT )

#define PLAYER_Y0 1
#define PLAYER_Y1 3

#define PLAYER_Y0_FP ( PLAYER_Y0 << BO_FP )
#define PLAYER_Y1_FP ( PLAYER_Y1 << BO_FP )

#define PLAYER_WIDTH 22
#define PLAYER_HEIGHT 3

#define PLAYER_WIDTH_FP ( PLAYER_WIDTH  << BO_FP )
#define PLAYER_HEIGHT_FP ( PLAYER_HEIGHT << BO_FP )

#define PLAYER_MAX_X FIELD_WIDTH - PLAYER_WIDTH + 2 //um
#define PLAYER_MIN_X 2

#define PLAYER_MAX_X_FP ( PLAYER_MAX_X << BO_FP )
#define PLAYER_MIN_X_FP ( PLAYER_MIN_Y << BO_FP )

#define PLAYER_X_ACCELERATION_FP ( 1 << ( BO_FP - 2 ) )
#define PLAYER_MAX_X_VELOCITY_FP ( 2 << BO_FP )

/* pixel values */
#define BO_FIELD_X0 2
#define BO_FIELD_Y0 2
#define BO_FIELD_X1 ( (uint8_t)( BO_FIELD_X0 + ( (BO_FIELD_WIDTH)>>BO_FP ) ) )
#define BO_FIELD_Y1 ( (uint8_t)( BO_FIELD_Y0 + ( (BO_FIELD_HEIGHT) >> BO_FP ) ) )
#define BO_FIELD_PIX_WIDTH ( (uint8_t)( (BO_FIELD_WIDTH) >> BO_FP ) )
#define BO_FIELD_PIX_HEIGHT ( (uint8_t)( (BO_FIELD_HEIGHT) >> BO_FP ) )

/* brick states */
#define BO_BRICK_NONE 0
#define BO_BRICK_NORMAL 1
#define BO_BRICK_SOLID 2
#define BO_BRICK_BALL 3




uint8_t uiKeyCodeFirst = KEY_NONE;
uint8_t uiKeyCodeSecond = KEY_NONE;
uint8_t uiKeyCode = KEY_NONE;
uint16_t uiIdleCount = 0;

struct bo_ball {
  int16_t dx;	/* fixed point 12.4 */
  int16_t dy;  /* fixed point 12.4 */
  int16_t x0;	/* fixed point 12.4 */
  int16_t x1;	/* fixed point 12.4 */
  int16_t y0;   /* fixed point 12.4 */
  int16_t y1;   /* fixed point 12.4 */
  int16_t lbr_x;	/* last brick reflection */
  int16_t lbr_y;	/* last brick reflection */
  unsigned is_ball_reflection;
  unsigned is_ball_lost;
};

bo_ball bo_ball1_obj;
bo_ball bo_ball2_obj;
bo_ball bo_ball3_obj;

struct bo_player
{
  int16_t w;	/* fixed point 12.4 */
  int16_t x0;	/* fixed point 12.4 */
  int16_t x1;	/* fixed point 12.4 */
  //int16_t y0;   /* fixed point 12.4 */
  //int16_t y1;   /* fixed point 12.4 */
  
  int16_t xv;
};

/*================================================================*/
/* breaker global variables */
/*================================================================*/
unsigned long next_sec_time;
uint8_t fps, frame_cnt;

byte bo_area[BO_AREA_HEIGHT][BO_AREA_WIDTH];
int16_t bo_player_brick_points; /* only written to... could  be removed */
int16_t bo_remaining_bricks;
int16_t bo_no_reflection_cnt = 0;

bo_player bo_player_obj;
uint8_t bo_step_state;
byte bo_timer;
byte bo_level;

#define BO_STATE_IN_GAME 1
#define BO_STATE_LOST 2
#define BO_STATE_RESTART 3
#define BO_STATE_COMPLETED 4
#define BO_STATE_INTRO 5
#define BO_STATE_INTRO1 6

#define DEFINED_LEVELS 4
#define L ( 1 + ( 3 << 2 ) )

 byte levels[][ 7 * 3 ] = { {  64,  84,  80, 209,  80,  84,  64,
                               64,  84,  68, 197,  68,  84,  64,
                               64, 213, 209, 209, 209, 213,  64 } };
                          /*{ 1, 1, 1, 1, 1, 1, 1,
                                1, 1, 1, 1, 1, 1, 1,
                                1, 1, 1, 1, 1, 1, 1 }, 
                              { 2, 2, 2, 2, 2, 2, 2,
                                2, 2, 2, 2, 2, 2, 2,
                                2, 2, 2, 2, 2, 2, 2 } };*/
                                
void bo_uiStep(void) {
  uint8_t is_key_pressed = 0;
  
  if ( digitalRead(uiKeyLeft) == LOW ) {
    is_key_pressed = 1;
    bo_player_obj.xv = max( -PLAYER_MAX_X_VELOCITY_FP, bo_player_obj.xv - PLAYER_X_ACCELERATION_FP );
  }
  
  if ( digitalRead(uiKeyRight) == LOW ) {
    is_key_pressed = 1;
    bo_player_obj.xv = min( PLAYER_MAX_X_VELOCITY_FP, bo_player_obj.xv + PLAYER_X_ACCELERATION_FP );
  }
    if ( digitalRead(uiKeyPrev) == LOW ) {
    is_key_pressed = 1;
  }
  
  if ( digitalRead(uiKeyNext) == LOW ) {
    is_key_pressed = 1;
  }
  
  if ( is_key_pressed == 0 ) {
    if ( bo_player_obj.xv > 0 ) {
      bo_player_obj.xv -= PLAYER_X_ACCELERATION_FP;
    } else if ( bo_player_obj.xv < 0 ) {
      bo_player_obj.xv += PLAYER_X_ACCELERATION_FP;
    }
  }
}

void bo_loop() {
  bo_Setup(0);
  while (bo_step_state != BO_STATE_LOST)
  {
    u8g.firstPage();
  
    do {
      bo_Draw();
      bo_DrawFPS(fps);
    } while( u8g.nextPage() );
  
    bo_uiStep();
    bo_SetPlayerPos( &bo_player_obj );
    bo_Step();
  }  
  u8g.firstPage();
  
    do {
      bo_Draw();
      bo_DrawFPS(fps);
    } while( u8g.nextPage() );
  
   EEPROM.write(SCORE_BYTE,bo_player_brick_points);
}

/*================================================================*/
/* Breakers APIs */
/*================================================================*/

void bo_Draw() {
    char points[45];
    draw_bricks();
    draw_ball(&bo_ball1_obj);
    draw_ball(&bo_ball2_obj);
    draw_ball(&bo_ball3_obj);
    draw_player(&bo_player_obj);
    ///draw_field(bo_level);
    
    
    if ( bo_step_state == BO_STATE_INTRO1 )
    {
      u8g.setRot180();
      u8g.drawStrP(20,4*L_FONT_HEIGHT, (const u8g_pgm_uint8_t*)PSTR("THOTCON 0x5"));
      u8g.undoRotation();
      
    }
    if ( bo_step_state == BO_STATE_LOST )
    {
      itoa(bo_player_brick_points , points, 10);
      u8g.setRot180();
      u8g.drawStrP(24,3*L_FONT_HEIGHT, (const u8g_pgm_uint8_t*)PSTR("GAME OVER"));
      u8g.drawStrP(24,4*L_FONT_HEIGHT, (const u8g_pgm_uint8_t*)PSTR("SCORE: "));
      u8g.drawStr(70,4*L_FONT_HEIGHT, points);
      u8g.undoRotation();
    }
    if ( bo_step_state == BO_STATE_COMPLETED )
    {

      u8g.setRot180();
      u8g.drawStrP(24,4*L_FONT_HEIGHT, (const u8g_pgm_uint8_t*)PSTR("COMPLETE!"));
      u8g.undoRotation();
    }
    
}

void bo_Step(void) {
  if ( bo_no_reflection_cnt >= 3 ) {
    bo_no_reflection_cnt-=3;
  }
  else {
    bo_no_reflection_cnt=0;
  }
  
  switch(bo_step_state) {
    case BO_STATE_INTRO:
      bo_step_state = BO_STATE_INTRO1;
      bo_timer = 80;
      break;
    case BO_STATE_INTRO1:
      bo_timer--;
      if ( bo_timer == 0 ) {
        bo_step_state = BO_STATE_IN_GAME;
      }
      break;
    case BO_STATE_IN_GAME:
      bo_DoBallStep( &bo_ball1_obj, &bo_player_obj );
      bo_DoBallStep( &bo_ball2_obj, &bo_player_obj );
      bo_DoBallStep( &bo_ball3_obj, &bo_player_obj );
      
      if ( bo_ball1_obj.is_ball_lost != 0 && bo_ball2_obj.is_ball_lost != 0  && bo_ball3_obj.is_ball_lost != 0 ) {
        bo_step_state = BO_STATE_LOST;
        bo_timer = 80;
      }
        
      bo_CalcRemainingBricks();
      
      if ( bo_remaining_bricks == 0 
           #if defined(DEBUG)
           || digitalRead(uiKeySelect) == LOW
           #endif 
           ) {
        bo_step_state = BO_STATE_COMPLETED;
        bo_timer = 80;
      }
      break;
    case BO_STATE_LOST:
      bo_timer--;
      if ( bo_timer == 0 ) {
        bo_step_state = BO_STATE_RESTART;
      }
      break;
    case BO_STATE_RESTART:
      bo_step_state = BO_STATE_IN_GAME;
      bo_Setup(0);
      break;
    case BO_STATE_COMPLETED:
      bo_timer--;
      if ( bo_timer == 0 ) {
        bo_step_state = BO_STATE_IN_GAME;
        bo_Setup( bo_level + 1 );
      }
  }
}

void bo_Setup(uint8_t level) {
  /* level = 4; */
  bo_no_reflection_cnt = 0;
  bo_level = level;
  bo_SetupBall(&bo_ball1_obj);
  bo_SetupBall(&bo_ball2_obj);
  bo_ball2_obj.is_ball_lost = 1;
  bo_SetupBall(&bo_ball3_obj);
  bo_ball3_obj.is_ball_lost = 1;
  bo_SetupPlayer(&bo_player_obj);
  bo_SetupLevel(level);
  if ( level == 0 )
    bo_step_state = BO_STATE_INTRO;
  else
    bo_step_state = BO_STATE_IN_GAME;
}

/*================================================================*/
/* setup */
/*================================================================*/

void bo_CalcRemainingBricks() {
  int w, h;
  int x, y;
  
  bo_remaining_bricks = 0;
  w = BO_AREA_WIDTH;
  h = BO_AREA_HEIGHT;
  
  for( y = 0; y < h; y++ ) {
    for( x = 0; x < w; x++ ) {
      if ( bo_area[y][x] == BO_BRICK_NORMAL || bo_area[y][x] == BO_BRICK_BALL )
	bo_remaining_bricks++;
    }
  }
}

void bo_SetupLevel( uint8_t level ) {
  int x, y;
  byte levelActual = level % DEFINED_LEVELS;
  byte shift = levelActual * 2;
  byte index = ( levelActual - ( levelActual % 4 ) ) / 4;
  
  for( y = 0; y < BO_AREA_HEIGHT; y++ ) {
    for( x = 0; x < BO_AREA_WIDTH; x++ ) {
      bo_area[y][x] = ( levels[index][ x + y * 7 ] >> shift ) & 3;
    }
  }
}

void bo_SetupBall( struct bo_ball *b ) {
  b->dx = ( 1 << BO_FP ) / 2;
  b->dy = ( 1 << BO_FP ) / 2;
  b->x0 = ( 1 << BO_FP );
  b->y0 = ( 1 << BO_FP ) + 2 * ( 1 << BO_FP );
  b->x1 = 5 * ( 1 << BO_FP );
  b->y1 = 5 * ( 1 << BO_FP ) + 2 * ( 1 << BO_FP );
  
  b->lbr_x = -1;
  b->lbr_y = -1;
  
  b->is_ball_lost = 0;
  b->is_ball_reflection = 0;
}

/* pos is between 0 and 255 */
void bo_SetPlayerPos( struct bo_player *p  ) {
  uint8_t tmp;
  
  //tmp = ( ( BO_FIELD_WIDTH - p->w - BO_FP ) >> BO_FP ) ;
  //tmp = (uint8_t)( ( (uint16_t)tmp * (uint16_t)pos ) / 255 );
  //p->x0 = ( (int16_t)tmp ) << BO_FP;
  //p->x1 = p->x0 + p->w;
  
  p->x0 = max( min( p->x0 + p->xv, PLAYER_MAX_X_FP ), 0 ) ;
  p->x1 = p->x0 + PLAYER_WIDTH_FP;
}

void bo_SetupPlayer( struct bo_player *p ) {
  p->w = PLAYER_WIDTH_FP; //(int16_t)22 * (int16_t)( 1 << BO_FP );
  ///bo_SetPlayerPos( p, 128 );
}

/*================================================================*/
/* graphics */
/*================================================================*/

void draw_bricks() {
  int x, y;
  int fx, fy;
  
  for( y = 0; y < BO_AREA_HEIGHT; y++ ) {
    for( x = 0; x < BO_AREA_WIDTH; x++ ) {
      fx = BO_AREA_ORIG_X + x * BO_AREA_UNIT_X;
      fy = BO_AREA_ORIG_Y + y * BO_AREA_UNIT_Y;
      fx >>= BO_FP;
      fy >>= BO_FP;
      fx += BO_FIELD_X0;
      fy += BO_FIELD_Y0;
      draw_brick(fx, fy, bo_area[y][x]);
    }
  }
}

void draw_brick(uint8_t ox, uint8_t oy, uint8_t brick_status) {
  int w = BRICK_WIDTH;
  int h = BRICK_HEIGHT;
  
  switch(brick_status) {
    case BO_BRICK_NORMAL:
      u8g.drawBox( ox, oy, w, h );
      return;
    case BO_BRICK_SOLID:
      u8g.drawBox( ox, oy, w, h );
      u8g.setColorIndex(0);
      u8g.drawBox( ox + 1, oy + 1, w - 2, h - 2 );
      u8g.setColorIndex(1);
      return;
    case BO_BRICK_BALL:
      u8g.drawBox( ox, oy, w, h );
      u8g.setColorIndex(0);
      u8g.drawVLine( ox + 2, oy + 1, oy + 3 );
      u8g.drawPixel( ox + 1, oy + 2 );
      u8g.drawPixel( ox + 3, oy + 2 );
      u8g.setColorIndex(1);
      return;
    default:
      return;
  }
}

void draw_ball( struct bo_ball *b ) {
  if ( b->is_ball_lost )
    return;
  
  u8g.drawBox( ( b->x0 >> BO_FP ) + BO_FIELD_X0, ( b->y0 >> BO_FP ) + BO_FIELD_Y0, BALL_SIZE, BALL_SIZE );
}

void draw_player( struct bo_player *p ) {
  uint8_t ox, oy, w, h;
  
  ox = ( p->x0 >> BO_FP ) + BO_FIELD_X0;
  oy = ( PLAYER_Y0 ) + BO_FIELD_Y0;
  
  u8g.drawBox( ox, oy, PLAYER_WIDTH, PLAYER_HEIGHT );
}

void bo_DrawFPS( uint8_t fps ) {
  if ( fps > 0 ) {
    ///dog_DrawStr(85, DOG_HEIGHT-8, BO_F1, dog_itoa(fps));
  }
}

void draw_field( uint8_t level ) {
  uint8_t x;
  
  ///dog_SetVLine(BO_FIELD_X0, BO_FIELD_Y0, BO_FIELD_Y1);
  ///dog_SetVLine(BO_FIELD_X1-1, BO_FIELD_Y0, BO_FIELD_Y1);
  ///x = dog_DrawStr(4, DOG_HEIGHT-8, BO_F1, dog_itoa(bo_remaining_bricks));
  ///x = dog_DrawStrP(25, DOG_HEIGHT-8, BO_F1, DOG_PSTR("level"));
  ///dog_DrawStr(x+2+25, DOG_HEIGHT-8, BO_F1, dog_itoa(level+1));

  if ( bo_no_reflection_cnt > 0 ) {
    ///dog_DrawStr(x+2+25+15, DOG_HEIGHT-8, BO_F1, dog_itoa((bo_no_reflection_cnt>>8)+1));
  }
}

/*================================================================*/
/* aux functions */
/*================================================================*/

uint8_t bo_IsIntersection( int16_t a_min, int16_t a_max, int16_t b_min, int16_t b_max) {
  if ( a_max < b_min )
    return 0;
  if ( a_min > b_max )
    return 0;
  return 1;
}

uint8_t bo_IsBallIntersection( struct bo_ball *b, int16_t x0, int16_t x1, int16_t y0, int16_t y1 ) {
  if ( b->is_ball_lost )
    return 0;
  if ( bo_IsIntersection( b->x0, b->x1, x0, x1 ) == 0 )
    return 0;
  if ( bo_IsIntersection( b->y0, b->y1, y0, y1 ) == 0 )
    return 0;
  return 1;
}

/*================================================================*/
/* intersection and reflection */
/*================================================================*/

/*===== brick and area intersection =====*/

/*
  test versus brick at position (x,y) [12.4]
  (x,y) is the lower left point of the brick
*/
uint8_t bo_IsBallBrickIntersection( struct bo_ball *b, int16_t x, int16_t y ) {
  return bo_IsBallIntersection( b, x, x + BO_BRICK_WIDTH, y, y + BO_BRICK_HEIGHT );
}

/* (x,y) is the lower left point of the brick */
void bo_DoBallBrickReflection( struct bo_ball *b, int16_t x, int16_t y ) {
  int16_t mx, my;
  
  if ( b->lbr_x == x && b->lbr_y == y )
    return;

  /* calculate middle of the ball */
  mx = ( b->x0 + b->x1 ) / 2;
  my = ( b->y0 + b->y1 ) / 2;
  
  if ( mx >= x && mx <= x + BO_BRICK_WIDTH ) {
    /* top/bottom or edge reflection */
    if ( my >= y && my <= y + BO_BRICK_HEIGHT ) {
      /* edge reflection */
      b->dx = - b->dx;
      b->dy = - b->dy;      
      b->is_ball_reflection = 1;
    } else {
      /* top/bottom or edge reflection */
      b->dy = - b->dy;      
      b->is_ball_reflection = 1;
    }
  } else {
    /* must be left or right reflection */
    b->dx = - b->dx;
    b->is_ball_reflection = 1;
  }
  
  b->lbr_x = x;
  b->lbr_y = y;
}

/* check area for the specified ball */
void bo_CheckBrickArea( struct bo_ball *b ) {
  int16_t gx;
  int16_t gy;
  uint8_t ix;
  uint8_t iy;
  uint8_t is_reflect = 0;
  
  gy = BO_AREA_ORIG_Y;
  iy = 0;
  
  while( iy < BO_AREA_HEIGHT ) {
    gx = BO_AREA_ORIG_X;
    ix = 0;
    while( ix < BO_AREA_WIDTH ) {
      switch ( bo_area[iy][ix] ) {
	case BO_BRICK_NORMAL:
	case BO_BRICK_SOLID:
	  if ( is_reflect == 0 )
	    if ( bo_IsBallBrickIntersection( b, gx, gy ) ) {
	      //if ( bo_area[iy][ix] == BO_BRICK_NO_REFLECTION )
		//bo_no_reflection_cnt = 9*256;
	      if ( bo_no_reflection_cnt == 0 ) {
		bo_DoBallBrickReflection( b, gx, gy );
		is_reflect = 1;
	      }
	      bo_player_brick_points++;
	      if ( bo_area[iy][ix] != BO_BRICK_SOLID ) {
		bo_area[iy][ix] = BO_BRICK_NONE;
	      }
	    }
	  break;
	case BO_BRICK_BALL:
	  if ( is_reflect == 0 )
	    if ( bo_IsBallBrickIntersection(b, gx, gy) ) {
	      bo_ball *bb;
	      /* look for lost ball */
	      if ( bo_ball1_obj.is_ball_lost != 0 )
		bb = &bo_ball1_obj;
	      else if ( bo_ball2_obj.is_ball_lost != 0 )
		bb = &bo_ball2_obj;
	      else if ( bo_ball3_obj.is_ball_lost != 0 )
		bb = &bo_ball3_obj;
	      else
		  bb = NULL;
	      if ( bb != NULL )
		*bb = *b;		/* clone the ball */
	      /* reflection only applies to the original ball */
	      bo_DoBallBrickReflection(b, gx, gy);
	      is_reflect = 1;
	      bo_player_brick_points++;
	      bo_area[iy][ix] = BO_BRICK_NONE;
	      return;
	    }
	  break;
	default:
	  break;
      }
      gx += BO_AREA_UNIT_X;
      ix++;
    }
    gy += BO_AREA_UNIT_Y;
    iy++;
  }  
}

/*===== field intersection =====*/

void bo_CheckField(bo_ball *b) {
  uint8_t is_reflection = 0;
  
  if ( b->x0 <= 0 ) {
    b->dx = -b->dx;
    is_reflection = 1;
  }
  if ( b->x1 >= BO_FIELD_WIDTH ) {
    b->dx = -b->dx;
    is_reflection = 1;
  }
  if ( b->y0 <= 0 ) {
    b->is_ball_lost = 1;
    b->dy = -b->dy;
    is_reflection = 1;
  }
  if ( b->y1 >= BO_FIELD_HEIGHT ) {
    b->dy = -b->dy;
    is_reflection = 1;
  }
  if ( is_reflection != 0 ) {
    b->is_ball_reflection = 1;
    /* reset last brick reflection */
    b->lbr_x = -1;
    b->lbr_y = -1;
  }
}

/*===== player intersection =====*/

uint8_t bo_IsBallPlayerIntersection( struct bo_ball *b, struct bo_player *p ) {
  if ( b->is_ball_lost )
    return 0;
  if ( bo_IsIntersection( b->x0, b->x1, p->x0, p->x1 ) == 0 )
    return 0;
  if ( bo_IsIntersection( b->y0, b->y1, PLAYER_Y0_FP, PLAYER_Y1_FP ) == 0 )
    return 0;
  return 1;
}

void bo_DoBallPlayerReflection( struct bo_ball *b, struct bo_player *p ) {
  int16_t mx, my;
  int16_t x;
  
  if ( b->is_ball_lost )
    return;

  /* reset last brick reflection */
  b->lbr_x = -1;
  b->lbr_y = -1;  
  
  /* calculate middle of the ball */
  mx = ( b->x0 + b->x1 ) / 2;
  my = ( b->y0 + b->y1 ) / 2 ;
  if ( mx >= p->x0 && mx <= p->x1 ) {
    /* top/bottom or edge reflection */
    if ( my >= PLAYER_Y0_FP && my <= PLAYER_Y1_FP ) {
      /* edge reflection */
      b->dx = - b->dx;
      b->dy = - b->dy;
      b->is_ball_reflection = 1;
    } else {
      /* top/bottom or edge reflection */
      
      b->dy = - b->dy;
      
      /* reduce dx, depending on how far the middle of the player paddle was hit */ 
      x = ( p->x1 + p->x0 ) / 2;
      x = x - mx;
      
      /* x can be between 0 an (p->w <<BO_FP)/2 */
      /* normalize x to 2<<(BO_FP)/2 */
      x /= p->w >> BO_FP;

      b->dx = -x;
      
      b->is_ball_reflection = 1;
    }
  } else {
    /* must be left or right reflection */
    b->dx = - b->dx;
    b->is_ball_reflection = 1;
  }
}

void bo_CheckPlayer( struct bo_ball *b, struct bo_player *p ) {
  if ( bo_IsBallPlayerIntersection(b, p) != 0 ) {
    bo_DoBallPlayerReflection(b, p);
  }
}

/*================================================================*/
/* handle a single ball */
/*================================================================*/

void bo_DoDeltaLimit( struct bo_ball *b ) { 
  if ( b->dx >= ( 1 << BO_FP ) ) {
    b->dx = ( 1 << BO_FP );
  }
  
  if ( b->dy >= ( 1 << ( BO_FP - 1 ) ) ) {
    b->dy = ( 1 << ( BO_FP - 1 ) );
  }
  
  if ( b->dy == 0 ) {
    b->dy = -( 1 << ( BO_FP - 1 ) );
    bo_DoBallDelta(b);
  }
}

void bo_DoBallDelta( struct bo_ball *b ) {
  b->x0 += b->dx;
  b->x1 += b->dx;
  b->y0 += b->dy;
  b->y1 += b->dy;
}

void bo_DoBallStep( struct bo_ball *b, struct bo_player *p ) {
  bo_DoDeltaLimit(b);
  bo_DoBallDelta(b);
  
  b->is_ball_reflection = 0;
  bo_CheckBrickArea(b);
  
  if ( b->is_ball_reflection == 0 ) {
    bo_CheckField(b);
    
    if ( b->is_ball_reflection == 0 ) {
      if ( p != NULL )
        bo_CheckPlayer(b, p);
    }
  }
  
  if ( b->is_ball_reflection != 0 ) {
    bo_DoBallDelta(b);
  }
}

//////GLYPHS////////////////

const uint8_t ox5 [] U8G_PROGMEM = {

0x00, 0x00, 0x00, 0x00, 0x00, 0x00, 0x00, 0x00, 0x00, 0x00, 0x00, 0x00, 0x00, 0x00, 0x00, 0x00,

0x00, 0x00, 0x00, 0x00, 0x0F, 0x03, 0x83, 0xCF, 0xFC, 0x0F, 0x03, 0x83, 0xCF, 0xFC, 0x31, 0xC3,

0xE7, 0xCE, 0x00, 0x31, 0xC1, 0xE7, 0x0F, 0xFC, 0xF0, 0xF1, 0xFF, 0x0F, 0xFC, 0xF0, 0xF0, 0x7E,

0x00, 0x0F, 0xF0, 0xF0, 0x7E, 0x00, 0x0F, 0xF0, 0xF1, 0xFF, 0x00, 0x0F, 0x38, 0xC1, 0xE7, 0x0E,

0x0F, 0x38, 0xC3, 0xE7, 0xCE, 0x0F, 0x0F, 0x03, 0x83, 0xC7, 0xFC, 0x0F, 0x03, 0x83, 0xC7, 0xFC,

0x00, 0x00, 0x00, 0x00, 0x00, 0x00, 0x00, 0x00, 0x00, 0x00, 0x00, 0x00, 0x00, 0x00, 0x00, 0x00,

0x00, 0x00, 0x00, 0x00, 

};

const uint8_t logo [] U8G_PROGMEM = {

0x00, 0x00, 0x00, 0x00, 0x00, 0x00, 0x00, 0x00, 0x00, 0x00, 0x00, 0x00, 0x00, 0x00, 0x00, 0x00,

0x00, 0x00, 0x00, 0x00, 0x00, 0x00, 0x00, 0x00, 0x00, 0x00, 0x00, 0x00, 0x00, 0x00, 0x00, 0x00,
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0x00, 0x00, 0x00, 0x00, 0x00, 0x00, 0x00, 0x00, 0x00, 0x00, 0x00, 0x00, 0x00, 0x00, 0x00, 0x00

};

#if defined HACKER_BADGE
const uint8_t icon [] U8G_PROGMEM = { //H

0x00, 0x00, 0x00, 0x00, 0x00, 0x00, 0x00, 0x00, 0x00, 0x00, 0x00, 0x00, 0x00, 0x00, 0x00, 0x00,

0x1F, 0xFF, 0xFF, 0xFF, 0xFF, 0xFF, 0xFF, 0xF8, 0x3F, 0xFF, 0xFF, 0xFF, 0xFF, 0xFF, 0xFF, 0xFC,
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0x00, 0x00, 0x00, 0x00, 0x00, 0x00, 0x00, 0x00, 0x00, 0x00, 0x00, 0x00, 0x00, 0x00, 0x00, 0x00

};
#endif

#if defined VIP_BADGE 
const uint8_t icon [] U8G_PROGMEM = { //X

0x00, 0x00, 0x00, 0x00, 0x00, 0x00, 0x00, 0x00, 0x3F, 0xFF, 0xFF, 0xFF, 0xFF, 0xFF, 0xFF, 0xFC,

0x7F, 0xFF, 0xFF, 0xFF, 0xFF, 0xFF, 0xFF, 0xFE, 0x7F, 0xFF, 0xFF, 0xFF, 0xFF, 0xFF, 0xFF, 0xFE,
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0x3F, 0xFF, 0xFF, 0xFF, 0xFF, 0xFF, 0xFF, 0xFC, 0x00, 0x00, 0x00, 0x00, 0x00, 0x00, 0x00, 0x00

};
#endif

#if defined OPER_BADGE
const uint8_t icon[] U8G_PROGMEM = { // O

0x00, 0x00, 0x00, 0x01, 0x80, 0x00, 0x00, 0x00, 0x00, 0x00, 0x00, 0xFF, 0xFF, 0x00, 0x00, 0x00,

0x00, 0x00, 0x07, 0xFF, 0xFF, 0xE0, 0x00, 0x00, 0x00, 0x00, 0x3F, 0xFF, 0xFF, 0xFC, 0x00, 0x00,
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0x00, 0x00, 0x00, 0xFF, 0xFF, 0x00, 0x00, 0x00, 0x00, 0x00, 0x00, 0x01, 0x80, 0x00, 0x00, 0x00

};
#endif

#if defined ROOT_BADGE
const uint8_t icon[] U8G_PROGMEM = { //R

0x1F, 0xFF, 0xFF, 0xFF, 0xFF, 0xFF, 0xFF, 0xFC, 0x7F, 0xFF, 0xFF, 0xFF, 0xFF, 0xFF, 0xFF, 0xFE,

0x7F, 0xFF, 0xFF, 0xFF, 0xFF, 0xFF, 0xFF, 0xFF, 0xFF, 0xFF, 0xFF, 0xFF, 0xFF, 0xFF, 0xFF, 0xFF,
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0x7F, 0xFF, 0xFF, 0xFF, 0xFF, 0xFF, 0xFF, 0xFE, 0x1F, 0xFF, 0xFF, 0xFF, 0xFF, 0xFF, 0xFF, 0xF8
};
#endif

#if defined VOICE_BADGE 
const uint8_t icon[] U8G_PROGMEM = { //V 

0x00, 0x00, 0x00, 0x00, 0x00, 0x00, 0x40, 0x00, 0x00, 0x00, 0x00, 0x00, 0x00, 0x00, 0x80, 0x00,

0x00, 0x00, 0x00, 0x00, 0x00, 0x03, 0x00, 0x00, 0x00, 0x00, 0x00, 0x00, 0x00, 0x03, 0x00, 0x00,
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0x00, 0x00, 0x00, 0x00, 0x00, 0x04, 0x00, 0x00, 0x00, 0x00, 0x00, 0x00, 0x00, 0x00, 0x00, 0x00
};
#endif

const uint8_t link[] U8G_PROGMEM = {

0x00, 0x0F, 0x00, 0x00, 0x00, 0x00, 0x00, 0x00, 0x00, 0x09, 0x00, 0x00, 0x00, 0x00, 0x00, 0x00,

0x00, 0x09, 0x00, 0x00, 0x00, 0x00, 0x00, 0x00, 0x00, 0x09, 0x00, 0x00, 0x00, 0x00, 0x00, 0x00,
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0x00, 0x00, 0x00, 0x00, 0x00, 0x00, 0x00, 0x00, 0x00, 0x00, 0x00, 0x00, 0x00, 0x00, 0x00, 0x00

};


const uint8_t qr[] U8G_PROGMEM = {

0x00, 0x00, 0x00, 0x00, 0x00, 0x00, 0x00, 0x00, 0x7F, 0xFF, 0xC0, 0x73, 0xE0, 0x07, 0xFF, 0xFE,

0x7F, 0xFF, 0xC0, 0x73, 0xE0, 0x07, 0xFF, 0xFE, 0x60, 0x01, 0xCE, 0x70, 0x7F, 0x07, 0x00, 0x0E,
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0x7F, 0xFF, 0xCE, 0x7C, 0x00, 0x18, 0xFF, 0xFE, 0x00, 0x00, 0x00, 0x00, 0x00, 0x00, 0x00, 0x00

};

const uint8_t u_dance[] U8G_PROGMEM = {

0x00, 0x00, 0x00, 0x00, 0x00, 0x00, 0x00, 0x00, 0x00, 0x00, 0x00, 0x00, 0x00, 0x00, 0x00, 0x00,

0x00, 0x00, 0x00, 0x00, 0x00, 0x00, 0x00, 0x00, 0x00, 0x00, 0x00, 0x00, 0x00, 0x00, 0x00, 0x00,
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0x03, 0xFF, 0x00, 0xFF, 0xC0, 0x00, 0x00, 0x00, 0x00, 0x03, 0xFF, 0x00, 0xFF, 0xC0, 0x00, 0x00

};

const unsigned char r_dance [] = {

0x00, 0x00, 0xf0, 0xff, 0x1f, 0x00, 0x00, 0x00, 0x00, 0x00, 0x00, 0x00,
   0x00, 0x00, 0x10, 0x00, 0x10, 0x00, 0x00, 0x00, 0x00, 0x00, 0x00, 0x00,
   0x00, 0x00, 0x10, 0x00, 0x10, 0x00, 0x00, 0x00, 0x00, 0x00, 0x00, 0x00,
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   0x00, 0x00, 0x00, 0x00, 0x00, 0x00, 0x00, 0x00, 0x00, 0x00, 0x00, 0x00 };


const uint8_t l_dance[] U8G_PROGMEM = {

0x00, 0x00, 0x00, 0x00, 0x00, 0x00, 0x00, 0x1F, 0xFF, 0xF0, 0x00, 0x00, 0x00, 0x00, 0x00, 0x00,
0x00, 0x00, 0x00, 0x10, 0x00, 0x10, 0x00, 0x00, 0x00, 0x00, 0x00, 0x00, 0x00, 0x00, 0x00, 0x10,
0x00, 0x10, 0x00, 0x00, 0x00, 0x00, 0x00, 0x00, 0x00, 0x00, 0x00, 0x10, 0x00, 0x10, 0x00, 0x00,
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0x00, 0x00, 0x00, 0x00, 0x00, 0x00, 0x00, 0x00, 0x00, 0x00, 0x00, 0x00, 0x00, 0x00, 0x00, 0x00
};

void uiSetup(void) {
  // initialize input keys , look to optimize w/ straight reg manipulation
  for (uint8_t i =0; i <= 30; i++)
  {
    if (i == 11 || i == 17 ) continue; // don't fuck with the display Data pins.
    pinMode(i,INPUT);
    digitalWrite(i,LOW);
  }
  
  pinMode(uiKeyPrev, INPUT);           // set pin to input
  digitalWrite(uiKeyPrev, HIGH);       // turn on pullup resistors
  pinMode(uiKeyNext, INPUT);           
  digitalWrite(uiKeyNext, HIGH);       
  pinMode(uiKeySelect, INPUT);          
  digitalWrite(uiKeySelect, HIGH);      
  pinMode(uiKeyBack, INPUT);           
  digitalWrite(uiKeyBack, HIGH);       
  pinMode(uiKeyLeft, INPUT);           
  digitalWrite(uiKeyLeft, HIGH);       
  pinMode(uiKeyRight, INPUT);           
  digitalWrite(uiKeyRight, HIGH);       
  pinMode(led, OUTPUT);
}


void uiStep(void) { // optimize out digitalRead
  uiKeyCodeSecond = uiKeyCodeFirst;
  if ( digitalRead(uiKeyPrev) == LOW )
    uiKeyCodeFirst = KEY_PREV;
  else if ( digitalRead(uiKeyNext) == LOW )
    uiKeyCodeFirst = KEY_NEXT;
  else if ( digitalRead(uiKeySelect) == LOW )
    uiKeyCodeFirst = KEY_SELECT;
  else if ( digitalRead(uiKeyBack) == LOW )
    uiKeyCodeFirst = KEY_BACK;
  else if ( digitalRead(uiKeyLeft) == LOW )
    uiKeyCodeFirst = KEYLEFT;
  else if ( digitalRead(uiKeyRight) == LOW )
    uiKeyCodeFirst = KEYRIGHT;
  else 
    uiKeyCodeFirst = KEY_NONE;
  
  if ( uiKeyCodeSecond == uiKeyCodeFirst )
    uiKeyCode = uiKeyCodeFirst;
  else
    uiKeyCode = KEY_NONE;
      #if defined (DEBUG)
      if(uiKeyCode){
          Serial.print("Key :");Serial.println(uiKeyCode);
      }
      #endif
}

const char mm1_str[] PROGMEM = "Game";
const char mm2_str[] PROGMEM = "Schedule";
const char mm3_str[] PROGMEM = "GameLink";
const char mm4_str[] PROGMEM = "Register";
const char mm5_str[] PROGMEM = "Help";
const char *main_menu_str[MENU_ITEMS] PROGMEM = {mm1_str ,mm2_str ,mm3_str ,mm4_str ,mm5_str};
const char sm1_str[] PROGMEM = "Track One";
const char sm2_str[] PROGMEM = "Track Two";
const char sm3_str[] PROGMEM = "Labs";
const char sm4_str[] PROGMEM = "Village";
const char sm5_str[] PROGMEM = "Party";
const char *sched_menu_str[MENU_ITEMS] PROGMEM  = {sm1_str, sm2_str,sm3_str ,sm4_str ,sm5_str};
const char _1t1t_str[] PROGMEM = "0830";
const char _1t2t_str[] PROGMEM = "0945";
const char _1t3t_str[] PROGMEM = "1000";
const char _1t4t_str[] PROGMEM = "1100";
const char _1t5t_str[] PROGMEM = "1200";
const char _1t6t_str[] PROGMEM = "1300";
const char _1t7t_str[] PROGMEM = "1400";
const char _1t8t_str[] PROGMEM = "1500";
const char _1t9t_str[] PROGMEM = "1600";
const char _1t10t_str[] PROGMEM = "1700";
const char _1t11t_str[] PROGMEM = "1730";
const char _1t12t_str[] PROGMEM = "1830";
const char _1t13t_str[] PROGMEM = "1930";
const char _1t14t_str[] PROGMEM = "2030";
const char _1t15t_str[] PROGMEM = "2100";
const char _1t16t_str[] PROGMEM = "2120";
const char *track1_time_str[TRACK1_ITEMS] PROGMEM  = {_1t1t_str,_1t2t_str,_1t3t_str,_1t4t_str,_1t5t_str,_1t6t_str,_1t7t_str,_1t8t_str,_1t9t_str,_1t10t_str,_1t11t_str,_1t12t_str,_1t13t_str,_1t14t_str,_1t15t_str,_1t16t_str};  
const char _2t1t_str[] PROGMEM = "1100";
const char _2t2t_str[] PROGMEM = "1130";
const char _2t3t_str[] PROGMEM = "1200";
const char _2t4t_str[] PROGMEM = "1230";
const char _2t5t_str[] PROGMEM = "1300";
const char _2t6t_str[] PROGMEM = "1430";
const char _2t7t_str[] PROGMEM = "1500";
const char _2t8t_str[] PROGMEM = "1530";
const char _2t9t_str[] PROGMEM = "1600";
const char _2t10t_str[] PROGMEM = "1630";
const char _2t11t_str[] PROGMEM = "1700";
const char _2t12t_str[] PROGMEM = "1730";
const char _2t13t_str[] PROGMEM = "1800";
const char *track2_time_str[TRACK2_ITEMS] PROGMEM  = {_2t1t_str,_2t2t_str,_2t3t_str,_2t4t_str,_2t5t_str,_2t6t_str,_2t7t_str,_2t8t_str,_2t9t_str,_2t10t_str,_2t11t_str,_2t12t_str,_2t13t_str};  
const char lt3_str[] PROGMEM = "1100";
const char lt4_str[] PROGMEM = "1200";
const char lt5_str[] PROGMEM = "1300";
const char lt6_str[] PROGMEM = "1400";
const char lt7_str[] PROGMEM = "1600";
const char lt8_str[] PROGMEM = "1700";
const char lt9_str[] PROGMEM = "1800";
const char *lab_time_str[LAB_ITEMS] PROGMEM  = {lt3_str,lt4_str,lt5_str,lt6_str,lt7_str,lt8_str,lt9_str};
const char _1t1tl_str[] PROGMEM = "DOORS";
const char _1t2tl_str[] PROGMEM = "HELLO";
const char _1t3tl_str[] PROGMEM = "UFOs\n and \nGovernment";
const char _1t4tl_str[] PROGMEM = "Crowdsourcing\nYour Cisco\nFirewalls";
const char _1t5tl_str[] PROGMEM = "Just What\nThe Doctor\nOrdered?";
const char _1t6tl_str[] PROGMEM = "BREAK";
const char _1t7tl_str[] PROGMEM = "The Perfectly\nLetimate Project";
const char _1t8tl_str[] PROGMEM = "It Ain't\nRocket Science";
const char _1t9tl_str[] PROGMEM = "Introducing idb";
const char _1t10tl_str[] PROGMEM = "BREAK";
const char _1t11tl_str[] PROGMEM = "Surveilling IP\nCera Security";
const char _1t12tl_str[] PROGMEM = "Phishing Frenzy";
const char _1t13tl_str[] PROGMEM = "Breaking Bus\nTickets";
const char _1t14tl_str[] PROGMEM = "HACKER BREW";
const char _1t15tl_str[] PROGMEM = "CLOSING";
const char _1t16tl_str[] PROGMEM = "";
const char *track1_title_str[TRACK1_ITEMS] PROGMEM  = {_1t1tl_str,_1t2tl_str,_1t3tl_str,_1t4tl_str,_1t5tl_str,_1t6tl_str,_1t7tl_str,_1t8tl_str,_1t9tl_str,_1t10tl_str,_1t11tl_str,_1t12tl_str,_1t13tl_str,_1t14tl_str,_1t15tl_str,_1t16tl_str};
const char _1t1n_str[] PROGMEM = "OPEN";
const char _1t2n_str[] PROGMEM = "c7five";
const char _1t3n_str[] PROGMEM = "Richard Thieme";
const char _1t4n_str[] PROGMEM = "Claudius && Guay";
const char _1t5n_str[] PROGMEM = "Scott Erven";
const char _1t6n_str[] PROGMEM = " DRINK BEER\nEAT FOODS ";
const char _1t7n_str[] PROGMEM = "O'Connor && Dobbe";
const char _1t8n_str[] PROGMEM = "David Mortman";
const char _1t9n_str[] PROGMEM = "Daniel A. Mayer";
const char _1t10n_str[] PROGMEM = " DRINK MORE BEER\nEAT MORE FOOD ";
const char _1t11n_str[] PROGMEM = "Mark Stanislov";
const char _1t12n_str[] PROGMEM = "McCann \n Ringwood";
const char _1t13n_str[] PROGMEM = "Mike Jackson";
const char _1t14n_str[] PROGMEM = "CONTEST RESULTS";
const char _1t15n_str[] PROGMEM = "REMARKS";
const char _1t16n_str[] PROGMEM = "SYS64738";
const char *track1_name_str[TRACK1_ITEMS] PROGMEM  = {_1t1n_str,_1t2n_str,_1t3n_str,_1t4n_str,_1t5n_str,_1t6n_str,_1t7n_str,_1t8n_str,_1t9n_str,_1t10n_str,_1t11n_str,_1t12n_str,_1t13n_str,_1t14n_str,_1t15n_str,_1t16n_str};
const char _2t1tl_str[] PROGMEM = "Digitial Attacks\nin the\nPhysical Realm";
const char _2t2tl_str[] PROGMEM = "Wireless\nDrone Strikes";
const char _2t3tl_str[] PROGMEM = "Poking Through\nto the Heart\nof a Binary";
const char _2t4tl_str[] PROGMEM = "Retroactive\nWiretapping";
const char _2t5tl_str[] PROGMEM = "BREAK";
const char _2t6tl_str[] PROGMEM = "Your Personal\nInformation\nIs Online?";
const char _2t7tl_str[] PROGMEM = "Electronic\nDevice Searches\nat the Border";
const char _2t8tl_str[] PROGMEM = "P.I.S.S.E.D";
const char _2t9tl_str[] PROGMEM = "BREAK";
const char _2t10tl_str[] PROGMEM = "Traits Between\nA Soc Eng\n& a Sociopath";
const char _2t11tl_str[] PROGMEM = "10 Commandments\nof IR\n(For Hackers)";
const char _2t12tl_str[] PROGMEM = "Yelling at\nmanagement...";
const char _2t13tl_str[] PROGMEM = " Bypassing\n EMET 4.1";
const char *track2_title_str[TRACK2_ITEMS] PROGMEM  = {_2t1tl_str,_2t2tl_str,_2t3tl_str,_2t4tl_str,_2t5tl_str,_2t6tl_str,_2t7tl_str,_2t8tl_str,_2t9tl_str,_2t10tl_str,_2t11tl_str,_2t12tl_str,_2t13tl_str};
const char _2t1n_str[] PROGMEM = "Grape Ape";
const char _2t2n_str[] PROGMEM = "Parker Schmitt";
const char _2t3n_str[] PROGMEM = "whistlepig";
const char _2t4n_str[] PROGMEM = "John Bambenek";
const char _2t5n_str[] PROGMEM = "DRINK BEER\nEAT FOODS";
const char _2t6n_str[] PROGMEM = "whitehat1969";
const char _2t7n_str[] PROGMEM = "Merrill";
const char _2t8n_str[] PROGMEM = "Joe Cicero";
const char _2t9n_str[] PROGMEM = "DRINK MORE BEER\nEAT MORE FOODS";
const char _2t10n_str[] PROGMEM = "J. Singleton";
const char _2t11n_str[] PROGMEM = "Lesley Carhart";
const char _2t12n_str[] PROGMEM = "Alex Muentz";
const char _2t13n_str[] PROGMEM = "Jared DeMott";
const char *track2_name_str[TRACK2_ITEMS] PROGMEM  = {_2t1n_str,_2t2n_str,_2t3n_str,_2t4n_str,_2t5n_str,_2t6n_str,_2t7n_str,_2t8n_str,_2t9n_str,_2t10n_str,_2t11n_str,_2t12n_str,_2t13n_str};
const char lab2tl_str[] PROGMEM = "Breaking\nEncryption\nw/ Oscilloscopes";
const char lab3tl_str[] PROGMEM = "Building a GPU\nCracking Rig";
const char lab4tl_str[] PROGMEM = "Synthetic Mobile\nMalware Analysis";
const char lab6tl_str[] PROGMEM = "The Cavalry is Us";
const char lab8tl_str[] PROGMEM = "Hardware\nHacking for\nCheap Dummies";
const char lab9tl_str[] PROGMEM = "Targeted Malware";
const char lab10tl_str[] PROGMEM = "";
const char *lab_title_str[LAB_ITEMS] PROGMEM  = {lab2tl_str,lab3tl_str,lab4tl_str,lab6tl_str,lab8tl_str,lab9tl_str,lab10tl_str};
const char lab2n_str[] PROGMEM = "Duehr && Balducci";
const char lab3n_str[] PROGMEM = "Fosaaen && Gruber";
const char lab4n_str[] PROGMEM = "David Shaw";
const char lab6n_str[] PROGMEM = "Brand && Erven\nBeau Woods";
const char lab8n_str[] PROGMEM = "Kevin Bong";
const char lab9n_str[] PROGMEM = "wartortell\n fuzzynop";
const char lab10n_str[] PROGMEM = "./SHUTDOWN";
const char *lab_name_str[LAB_ITEMS] PROGMEM  = {lab2n_str,lab3n_str,lab4n_str,lab6n_str,lab8n_str,lab9n_str,lab10n_str};
const char vt1_str[] PROGMEM = "Table 0";
const char vt2_str[] PROGMEM = "Table 1";
const char vt3_str[] PROGMEM = "Table 2";
const char vt4_str[] PROGMEM = "Table 3";
const char vt5_str[] PROGMEM = "Table 4";
const char vt6_str[] PROGMEM = "Table 5";
const char vt7_str[] PROGMEM = "Table 6";
const char *village_time_str[VILLAGE_ITEMS] PROGMEM  = {vt1_str,vt2_str,vt3_str,vt4_str,vt5_str,vt6_str,vt7_str};   
const char v1tl_str[] PROGMEM = "Workshop 88" ;
const char v2tl_str[] PROGMEM = "Hackers\n for\n Charity ";
const char v3tl_str[] PROGMEM = "Lock Pick \nVillage";
const char v4tl_str[] PROGMEM = "HACKER BREW\nCONTEST";
const char v5tl_str[] PROGMEM = "OWASP";
const char v6tl_str[] PROGMEM = "Circle City Con";
const char v7tl_str[] PROGMEM = "The Cavalry";
const char *village_title_str[VILLAGE_ITEMS] PROGMEM  = {v1tl_str,v2tl_str,v3tl_str,v4tl_str,v5tl_str,v6tl_str,v7tl_str};
 
uint8_t menu_current = 0;
uint8_t menu_redraw = 0;
uint8_t info_current = 0;
uint8_t last_key_code = KEY_NONE;
uint8_t global_state = MAIN_STATE;

void drawMenu(const char **str) {
  uint8_t i;
  u8g_uint_t d;
  
  u8g.firstPage();
  do  {
    u8g.setFont(u8g_font_6x12r);
    u8g.setFontRefHeightText();
    u8g.setFontPosTop();

    for( i = 0; i < MENU_ITEMS; i++ ) {
      d = (DISPLAY_WIDTH-u8g.getStrWidthP((u8g_uint_t*)pgm_read_word(&(str[i]))))/2;
      u8g.setDefaultForegroundColor();
      if ( i == menu_current ) {
        u8g.drawBox(0, i*L_FONT_HEIGHT+1, DISPLAY_WIDTH, L_FONT_HEIGHT);
        u8g.setDefaultBackgroundColor();
      }
      u8g.drawStrP(d, i*L_FONT_HEIGHT,(const u8g_uint_t*)pgm_read_word(&str[i]));  
    }
  } while( u8g.nextPage() );
}

void drawMenuInfo(){
  uint8_t track; //= ((global_state >>4) & 1) ? 0: ((global_state >>5)&1) ? 1: ((global_state >>6)&1) ? 2 : 3;
  const char** time_str;
  const char** title_str;
  const char** name_str;
  byte pos= 0;
  uint16_t ptr= 0;
  char trimmed[L_FONT_LENGTH] = {'\0'};
  u8g_uint_t d=0;
  byte line = 2;
  
  switch (global_state){ //set pointers based on track
      case TRACK_ONE_STATE:
         track = 0;
         time_str = track1_time_str;
         title_str = track1_title_str;
         name_str = track1_name_str;
         break;
      case TRACK_TWO_STATE:
         track = 1;
         time_str = track2_time_str;
         title_str = track2_title_str;
         name_str = track2_name_str;
         break;
      case LABS_STATE:
         track = 2;
         time_str = lab_time_str;
         title_str = lab_title_str;
         name_str = lab_name_str;
         break;
      case VILLAGE_STATE: 
        track = 3;
        time_str = village_time_str;
        title_str = village_title_str;
        name_str = track1_name_str;
      break;
  }
  u8g.firstPage();
  do  { // draw page
    u8g.setFont(u8g_font_6x12r);
    u8g.setFontRefHeightText();
    u8g.setFontPosTop();
    // Track
    d = (DISPLAY_WIDTH-u8g.getStrWidthP((u8g_uint_t*)pgm_read_word(&sched_menu_str[track])))/2;
    u8g.drawStrP(d, 0,(const u8g_uint_t*)pgm_read_word(&sched_menu_str[track]));
    //Time
    d = (DISPLAY_WIDTH-u8g.getStrWidthP((u8g_uint_t*)pgm_read_word(&time_str[info_current])))/2;
    u8g.drawStrP(d, L_FONT_HEIGHT,(const u8g_uint_t*)pgm_read_word(&time_str[info_current]));
    u8g.drawLine(0,2*L_FONT_HEIGHT,DISPLAY_WIDTH,2*L_FONT_HEIGHT);
    //Talk
     if (u8g.getStrWidthP((u8g_uint_t*)pgm_read_word(&title_str[info_current])) > DISPLAY_WIDTH )
     //string too long, trim and print
     {
         pos = 0;
         line = 2;
         ptr = (uint16_t)pgm_read_word(&title_str[info_current]);
         do
         {
           trimmed[pos++] = (char) pgm_read_byte(ptr) ; //there should be bounds checking here but we control the strings beware stack corruption
           if ((char) pgm_read_byte(ptr++) == '\0') break;
           if ((char) pgm_read_byte(ptr) == '\n'){         
             #if defined DEBUG
             Serial.println(trimmed);
             #endif
             trimmed[pos] = '\0';
             d = (DISPLAY_WIDTH - u8g.getStrWidth(trimmed))/2;
             u8g.drawStr(d,line*L_FONT_HEIGHT,trimmed);
             pos = 0;
             line++;
             ptr++;
           }
         } while (pgm_read_byte(ptr) != '\0' );
         trimmed[pos] = '\0';
         d = (DISPLAY_WIDTH - u8g.getStrWidth(trimmed))/2;
         u8g.drawStr(d,line*L_FONT_HEIGHT,trimmed);
     }
     else {   //string fits, just print     
     d = (DISPLAY_WIDTH-u8g.getStrWidthP((u8g_uint_t*)pgm_read_word(&title_str[info_current])))/2;
     u8g.drawStrP(d,2*L_FONT_HEIGHT+1,(const u8g_uint_t*)pgm_read_word(&title_str[info_current]));
     }
    //Speaker
     if (global_state == VILLAGE_STATE) continue;
     if (u8g.getStrWidthP((u8g_uint_t*)pgm_read_word(&name_str[info_current])) > DISPLAY_WIDTH )
     //string too long, trim and print
     {
         pos = 0;
         ptr = (uint16_t)pgm_read_word(&name_str[info_current]);
         do
         {
           trimmed[pos++] = (char) pgm_read_byte(ptr) ; //there should be bounds checking here but we control the strings beware stack corruption
           if ((char) pgm_read_byte(ptr++) == '\0'){
                        
             break;
           }
           if ((char) pgm_read_byte(ptr) == '\n'){         
            
             trimmed[pos] = '\0';
             d = (DISPLAY_WIDTH - u8g.getStrWidth(trimmed))/2;
             u8g.drawStr(d,line*L_FONT_HEIGHT,trimmed);
             pos = 0;
             line++;
             ptr++;
           }
         } while (pgm_read_byte(ptr) != '\0' );
         trimmed[pos] = '\0';
         #if defined DEBUG
         Serial.println(trimmed);
         Serial.println(line);
         #endif 
         d = (DISPLAY_WIDTH - u8g.getStrWidth(trimmed))/2;
         u8g.drawStr(d,line*L_FONT_HEIGHT,trimmed);
        
         line = 3;
     }
     else {
     d = (DISPLAY_WIDTH-u8g.getStrWidthP((u8g_uint_t*)pgm_read_word(&name_str[info_current])))/2;
     u8g.drawStrP(d,5*L_FONT_HEIGHT,(const u8g_uint_t*)pgm_read_word(&name_str[info_current]));
     }
  } while( u8g.nextPage() );
 
}

#define UP       0x01
#define DOWN     0x02
#define LEFT     0x04
#define RIGHT    0x08
#define A_BUTTON 0x10
#define B_BUTTON 0x20


byte buttonMask = 0;
byte lastMask=0;

void toggleKey(char key, int val)
{
  if(val)
    Keyboard.press(key);
  else
    Keyboard.release(key);
}

void calculateMask()
{
  buttonMask=0;
  if ( digitalRead(uiKeyPrev) == LOW )
    buttonMask=UP;
  if ( digitalRead(uiKeyNext) == LOW )
    buttonMask|=DOWN;
  if ( digitalRead(uiKeySelect) == LOW )
    buttonMask|=A_BUTTON;
  if ( digitalRead(uiKeyBack) == LOW )
    buttonMask|=B_BUTTON;
  if ( digitalRead(uiKeyLeft) == LOW )
    buttonMask|=LEFT;
  if ( digitalRead(uiKeyRight) == LOW )
    buttonMask|=RIGHT;
}

void draw_link()
{
 
 
  u8g.firstPage();
  do{
    u8g.drawStrP(3,3*L_FONT_HEIGHT,(const u8g_pgm_uint8_t*)PSTR("   P1      P2    "));
    u8g.drawStrP(3,4*L_FONT_HEIGHT,(const u8g_pgm_uint8_t*)PSTR("   B        A    "));
  } while(u8g.nextPage() );
  delay(500);
  u8g.firstPage();
  while(1) {
    uiStep();
    if(uiKeyCode == KEY_BACK) {
       isPlayer1=1;
       break;
    }
    else if(uiKeyCode == KEY_SELECT) {
       isPlayer1=0; 
       break;
    }
  }
  do {
    u8g.drawBitmapP(35, 8, 8, 64, link);
  } while (u8g.nextPage() );
  Keyboard.begin();
  while(USBSTA&(1<<VBUS)){  //checks state of VBUS
      int i=0;
      byte change=0;
 
      digitalWrite(led,HIGH);
      lastMask=buttonMask;
      calculateMask();
      change = lastMask^buttonMask;
      
      if(isPlayer1) {
        if(change&UP)
          toggleKey(KEY_UP_ARROW, buttonMask&UP);
        if(change&DOWN)
          toggleKey(KEY_DOWN_ARROW, buttonMask&DOWN);
        if(change&LEFT)
          toggleKey(KEY_LEFT_ARROW, buttonMask&LEFT);
        if(change&RIGHT)
          toggleKey(KEY_RIGHT_ARROW, buttonMask&RIGHT);
        if(change&A_BUTTON)
          toggleKey(KEY_LEFT_CTRL, buttonMask&A_BUTTON);
        if(change&B_BUTTON)
          toggleKey(KEY_LEFT_ALT, buttonMask&B_BUTTON);
      } else {
        if(change&UP)
          toggleKey('i', buttonMask&UP);
        if(change&DOWN)
          toggleKey('k', buttonMask&DOWN);
        if(change&LEFT)
          toggleKey('j', buttonMask&LEFT);
        if(change&RIGHT)
          toggleKey('l', buttonMask&RIGHT);
        if(change&A_BUTTON)
          toggleKey('o', buttonMask&A_BUTTON);
        if(change&B_BUTTON)
          toggleKey('u', buttonMask&B_BUTTON);
      }

    }
    Keyboard.end();
    digitalWrite(led,LOW);
}

void draw_reg()
{
  char ID_str[9] = {'\0'};
  for (uint8_t i = 0; i < 9; i++)
          ID_str[i] = EEPROM.read(i);
  ID_str[8] = '\0';
  #if defined DEBUG
  Serial.println(ID_str);
  #endif
  u8g.firstPage();
  do {
    u8g.drawStrP(12, L_FONT_HEIGHT,(const u8g_pgm_uint8_t*)PSTR("Register Here:"));
    u8g.drawLine(0,2*L_FONT_HEIGHT,DISPLAY_WIDTH,2*L_FONT_HEIGHT);
     u8g.drawStrP(20,2*L_FONT_HEIGHT,(const u8g_pgm_uint8_t*)PSTR("badges (dot)"));
     u8g.drawStrP(8,3*L_FONT_HEIGHT,(const u8g_pgm_uint8_t*)PSTR("workshop88.com"));
    uint8_t d = (DISPLAY_WIDTH - u8g.getStrWidth(ID_str))/2;
    u8g.drawStr(d,5*L_FONT_HEIGHT,ID_str);
  } while (u8g.nextPage() );
  
  
  //delay(3000);
}

void draw_party(){
    u8g.setColorIndex(1);
   u8g.firstPage();
  do {
    u8g.drawStrP(20, 0,(const u8g_pgm_uint8_t*)PSTR("AFTERPARTY"));
    u8g.drawStrP(12,L_FONT_HEIGHT,(const u8g_pgm_uint8_t*)PSTR("Saturday 4/26"));
    u8g.drawLine(0,2*L_FONT_HEIGHT,DISPLAY_WIDTH,2*L_FONT_HEIGHT);
    u8g.drawStrP(8,2*L_FONT_HEIGHT,(const u8g_pgm_uint8_t*)PSTR("TheUnderground"));
    u8g.drawStrP(3,3*L_FONT_HEIGHT,(const u8g_pgm_uint8_t*)PSTR("56 W Illinois St"));
    u8g.drawStrP(1,4*L_FONT_HEIGHT,(const u8g_pgm_uint8_t*)PSTR("Chicago, IL 60654"));
    
  } while (u8g.nextPage() ); 
  delay(3000);
  u8g.firstPage();
  do{
    u8g.drawStrP(1,2*L_FONT_HEIGHT,(const u8g_pgm_uint8_t*)PSTR("Is it Party Time?"));
    u8g.drawStrP(3,3*L_FONT_HEIGHT,(const u8g_pgm_uint8_t*)PSTR("   No      Yes   "));
    u8g.drawStrP(3,4*L_FONT_HEIGHT,(const u8g_pgm_uint8_t*)PSTR("   B        A    "));
  } while(u8g.nextPage() );
}

void draw_icon(const u8g_pgm_uint8_t* glyph)
{
  u8g.firstPage();
  do {
    u8g.drawBitmapP(19, 0, 8, 64, glyph);
  } while (u8g.nextPage() );
  delay(3000);
  
}

void scroll_intro()
{
  uint8_t y= 0;
 
  
  for (y =0 ; y <= 52; y++)
  {
      u8g.firstPage();
      do {
      u8g.drawBitmapP(0,(64-y),12,20,logo);
      } while (u8g.nextPage() );
    delay(50);
  }
  delay(1000);
  u8g.firstPage();
  do{
    u8g.drawBitmapP(0,12,12,20,logo);
    u8g.drawBitmapP(31,24,5,20,ox5);
  } while (u8g.nextPage());
  delay (3000);
}

void draw_help(){
   u8g.setColorIndex(1);
   u8g.firstPage();
  do {
    /*u8g.drawStrP(8, 0,(const u8g_pgm_uint8_t*)PSTR("SPECS/HAX/INFO"));
    u8g.drawStrP(18,L_FONT_HEIGHT,(const u8g_pgm_uint8_t*)PSTR("Workshop 88"));
    u8g.drawLine(0,L_FONT_HEIGHT,DISPLAY_WIDTH,L_FONT_HEIGHT);
    u8g.drawStrP(8,2*L_FONT_HEIGHT,(const u8g_pgm_uint8_t*)PSTR("badges"));
    u8g.drawStrP(3,3*L_FONT_HEIGHT,(const u8g_pgm_uint8_t*)PSTR("(dot)workshop88(dot)"));
    u8g.drawStrP(1,4*L_FONT_HEIGHT,(const u8g_pgm_uint8_t*)PSTR("com"));
    */
    u8g.drawBitmapP(19, 0, 8, 64, qr);
  
     
  } while (u8g.nextPage()); 
  delay(3000);
}

void drawLong(const u8g_pgm_uint8_t* glyph)
{
  u8g.firstPage();
  do {
    u8g.drawBitmapP(3, 0, 12, 64, glyph);
  } while (u8g.nextPage() );  
}

void drawShort(const u8g_pgm_uint8_t* glyph)
{
  u8g.firstPage();
  do {
    u8g.drawBitmapP(15, 0, 9, 64, glyph);
  } while (u8g.nextPage() );  
}

void danceParty(){
    uint8_t psuedo = 0;
    uiIdleCount = 0;
    while (uiIdleCount < 30)
    {
      uiStep();
      if (uiKeyCode == KEY_BACK) break;
      // check for key press
      if (uiKeyCode == KEY_NONE)
      {
           uiIdleCount++;
           delay(IDLE_MS); // wait a very short period to help calculate idleness  
      }
      else {
         uiIdleCount = 0;
      }
      psuedo = uiIdleCount % 3;
      u8g.undoRotation();
      u8g.setColorIndex(1);
      switch (psuedo)
      { 
           case 0: drawLong(l_dance);
           case 1: drawShort(u_dance);
           case 2: drawLong(l_dance);
           default: break;
             
      }
      u8g.setRot180();
      digitalWrite(led, HIGH);  
      delay((psuedo % 4) * 200);              
      digitalWrite(led, LOW);   
      delay(0250);
      #if defined (DEBUG)
      Serial.print("pseduo: ");Serial.println(psuedo);
      #endif
    } 
  
} //danceParty

void help_SOS() //optimize candidate
{
  digitalWrite(led, HIGH);  
  delay(0250);              
  digitalWrite(led, LOW);   
  delay(0250);               
  
  digitalWrite(led, HIGH);   
  delay(0250);               
  digitalWrite(led, LOW);    
  delay(0250);               

  digitalWrite(led, HIGH);   
  delay(0250);               
  digitalWrite(led, LOW);    
  delay(0500);               

  digitalWrite(led, HIGH);   
  delay(1000);               
  digitalWrite(led, LOW);   
  delay(0250);              

  digitalWrite(led, HIGH);   
  delay(1000);               
  digitalWrite(led, LOW);    
  delay(0250);               

  digitalWrite(led, HIGH);   
  delay(1000);               
  digitalWrite(led, LOW);    
  delay(0250);               

  digitalWrite(led, HIGH);  
  delay(0250);               
  digitalWrite(led, LOW);    
  delay(0250);               

  

  digitalWrite(led, HIGH);   
  delay(0250);               
  digitalWrite(led, LOW);    
  delay(0250);               
  
  digitalWrite(led, HIGH);   
  delay(0250);               
  digitalWrite(led, LOW);    
               
  menu_redraw = 1;
}

void menu_state()
{
    #if defined(DEBUG)
    Serial.print("G_state: "); Serial.println(global_state);
    Serial.print("Menu_curr: "); Serial.println(menu_current);
    Serial.print("Info_curr: "); Serial.println(info_current);
    #endif
    switch(global_state) {
    case GAME_STATE:  u8g.undoRotation(); bo_loop(); u8g.setRot180();  break;
    case SCHED_STATE: menu_redraw = 1; drawMenu(sched_menu_str); menu_redraw = 0; break;
    case LINK_STATE: isPlayer1=1; draw_link(); break;
    case REG_STATE: /*draw_icon(qr);*/ draw_reg(); break;
    case HELP_STATE:menu_redraw = 1; draw_help(); help_SOS(); menu_redraw=0; break;
    case TRACK_ONE_STATE:
    case TRACK_TWO_STATE:
    case LABS_STATE:  
    case VILLAGE_STATE: drawMenuInfo(); break;
    case PARTY_STATE: menu_redraw = 1; draw_party(); menu_redraw = 0; break;
    default: drawMenu(main_menu_str); break;
  }
    return;
}


void updateMenu(void) {
  if ( uiKeyCode != KEY_NONE && last_key_code == uiKeyCode ) {
    return;
  }
  last_key_code = uiKeyCode;
  byte max_items = 0;
  switch (global_state){
    case TRACK_ONE_STATE: max_items = TRACK1_ITEMS; break;
    case TRACK_TWO_STATE: max_items = TRACK2_ITEMS; break;
    case LABS_STATE:  max_items = LAB_ITEMS; break;
    case VILLAGE_STATE: max_items = VILLAGE_ITEMS; break;
    default: max_items = MENU_ITEMS; break;
  }
  switch ( uiKeyCode ) {
    case KEY_NEXT: //down
      if (global_state < 16 || global_state == MAIN_STATE){
        menu_current++;
        if ( menu_current >= MENU_ITEMS )
          menu_current = 0;
      }
      else {
        info_current++;
        if ( info_current >= max_items )
          info_current = 0;
      }
      menu_redraw = 1;
      break;
    case KEY_PREV: //up
      if (global_state < 16 || global_state == MAIN_STATE) {
         if ( menu_current == 0 )
          menu_current = MENU_ITEMS;
        menu_current--;
      }
      else {
        
        if ( info_current == 0 )
          info_current = max_items;
        info_current--;
      }
      menu_redraw = 1;
      break;
    case KEY_SELECT:
      if ( global_state == MAIN_STATE)
      {
        global_state = menu_current;
        menu_current = 0;
        menu_state();
      }
      else if ( global_state == SCHED_STATE)
      {
        global_state = (menu_current == (MENU_ITEMS - 1)) ? PARTY_STATE : ( SCHED_STATE << (4 + menu_current));
        #if defined (DEBUG)
        Serial.print("Global state to: "); Serial.println(global_state);
        #endif
        if (info_current > max_items ) info_current = max_items;
        menu_state();

      }
      else if (global_state == PARTY_STATE)
      {
         danceParty(); 
      }
       
      break;
   case KEY_BACK:
      global_state = ((global_state > 15) && (global_state != MAIN_STATE) ) ? SCHED_STATE : MAIN_STATE;
      menu_current = 0;
      menu_state();
      break;
   }

}

void setup() {
  ADCSRA = 0; //disable analog block
  USBCON|=(1<<OTGPADE); //enables VBUS pad
  uiIdleCount = 0;
  
  u8g.setRot180();
  u8g.setColorIndex(1);
  uiIdleCount = 0;
  uiSetup();  // setup key detection and debounce algorithm
  menu_redraw = 1;     // force initial redraw
  #if defined(DEBUG)
     Serial.begin(9600);
  #endif 
  if (EEPROM.read(IDLE_BYTE))
  {
     scroll_intro();
     draw_icon(icon);
  }
  EEPROM.write(IDLE_BYTE,0x1);

}

void loop() {  

  uiStep();                  // check for key press
  if (uiKeyCode == KEY_NONE)
  {
         uiIdleCount++;
         delay(IDLE_MS); // wait a very short period to help calculate idleness  
  }
  else {
    uiIdleCount = 0;
  }
  if (uiIdleCount > IDLE_SCALE ) //idle > 30 sec
  {
    u8g.undoRotation();
    u8g.setColorIndex(1);
    draw_icon(icon);
    u8g.setRot180();
     uiIdleCount = 0;
     
    EEPROM.write(IDLE_BYTE,0x0);
    set_sleep_mode(SLEEP_MODE_PWR_DOWN);
    sleep_enable();
    sleep_cpu();
    sleep_disable();
    uiIdleCount = 0;
  }
  
  if (  menu_redraw != 0 ) {
 
      menu_state();
  } 
  menu_redraw = 0;
  

  updateMenu();                            // update menu bar
  /*#if defined (DEBUG)
  Serial.print("Idle: ");Serial.println(uiIdleCount);
  #endif
  */
}
